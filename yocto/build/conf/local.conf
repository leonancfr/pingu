## yocto/build/conf/local.conf
```bitbake
MACHINE ??= "raspberrypi4-64"

ENABLE_DWC2_HOST = "1"

DISTRO = "pingu"

hostname:pn-base-files = "pingu.local"

PACKAGE_CLASSES ?= "package_rpm"

USER_CLASSES ?= "buildstats"

PATCHRESOLVE = "noop"

BB_DISKMON_DIRS ??= "\
    STOPTASKS,${TMPDIR},1G,100K \
    STOPTASKS,${DL_DIR},1G,100K \
    STOPTASKS,${SSTATE_DIR},1G,100K \
    STOPTASKS,/tmp,100M,100K \
    HALT,${TMPDIR},100M,1K \
    HALT,${DL_DIR},100M,1K \
    HALT,${SSTATE_DIR},100M,1K \
    HALT,/tmp,10M,1K"

IMAGE_ROOTFS_EXTRA_SPACE = "256000"

IMAGE_INSTALL:append = " libstdc++"
IMAGE_INSTALL:append = " sudo"
IMAGE_INSTALL:append = " sqlite3"
IMAGE_INSTALL:append = " cronie"
IMAGE_INSTALL:append = " htop"
IMAGE_INSTALL:append = " bash bash-completion"
IMAGE_INSTALL:append = " vim"
IMAGE_INSTALL:append = " busybox"
IMAGE_INSTALL:append = " python3"
IMAGE_INSTALL:append = " ntp"
IMAGE_INSTALL:append = " docker-ce"
IMAGE_INSTALL:append = " openvpn"
IMAGE_INSTALL:append = " git-perltools"
IMAGE_INSTALL:append = " curl"
IMAGE_INSTALL:append = " parted e2fsprogs-resize2fs"
IMAGE_INSTALL:append = " systemd-analyze"
IMAGE_INSTALL:append = " libgpiod libgpiod-tools"

PACKAGE_INSTALL:append = " cryptsetup openssl"

IMAGE_INSTALL:append = " exfat-utils"
IMAGE_INSTALL:append = " ethtool"
IMAGE_INSTALL:append = " coreutils"
IMAGE_INSTALL:append = " xsystem"
IMAGE_INSTALL:append = " xdisk xdisksystemd"
IMAGE_INSTALL:append = " socketxp"
IMAGE_INSTALL:append = " socketxp-handler-systemd"
IMAGE_INSTALL:append = " prepare-data-apps-systemd"
IMAGE_INSTALL:append = " install-edge-crane-systemd"
IMAGE_INSTALL:append = " hardware-bridge-systemd"
IMAGE_INSTALL:append = " block-device-attach-systemd"
IMAGE_INSTALL:append = " block-device-change-systemd"
IMAGE_INSTALL:append = " block-device-detach-systemd"
IMAGE_INSTALL:append = " block-device-checker-systemd"
IMAGE_INSTALL:append = " pingu-updater-systemd"
IMAGE_INSTALL:append = " modem-manager-systemd"
IMAGE_INSTALL:append = " modem-checker-systemd"
IMAGE_INSTALL:append = " update-hostname-systemd"
IMAGE_INSTALL:append = " disable-eee-systemd"
IMAGE_INSTALL:append = " rp2040-start-systemd"
IMAGE_INSTALL:append = " rp2040-stop-systemd"
IMAGE_INSTALL:append = " move-buried-files-systemd"


IMAGE_INSTALL:append = " firmware-eth1"
IMAGE_INSTALL:append = " gabriel-binaries"
IMAGE_INSTALL:append = " prepare-system-rev-systemd"
IMAGE_INSTALL:append = " openocd-rp2040"
IMAGE_INSTALL:append = " udev-rules"
IMAGE_INSTALL:append = " useradd"
IMAGE_INSTALL:append = " config-venv"
IMAGE_INSTALL:append = " quectel"
IMAGE_INSTALL:append = " python3-pyserial"
IMAGE_INSTALL:append = " firmware-rp2040"

EXTRA_IMAGE_FEATURES:append = " ssh-server-openssh"
EXTRA_IMAGE_FEATURES:remove = " debug-tweaks empty-root-password"

VIRTUAL-RUNTIME_init_manager = " systemd"
VIRTUAL-RUNTIME_initscripts = ""

HOSTTOOLS_NONFATAL += "sudo pidof dockerd podman newgidmap newuidmap"
SERIAL_CONSOLES = ""

CONF_VERSION = "2"
```

## yocto/sources/meta-gabriel/conf/distro/pingu.conf
```bitbake
include conf/distro/poky.conf

DISTRO = "pingu"
DISTRO_NAME = "Pingu (°)>. A Linux distro for IoT developed by Gabriel Tecnologia."
DISTRO_VERSION = "1.16.5"

DISTRO_FEATURES:append = " virtualization"
DISTRO_FEATURES:append = " systemd"
DISTRO_FEATURES_BACKFILL_CONSIDERED = "sysvinit"
```

## yocto/sources/meta-gabriel/conf/layer.conf
```bitbake
# We have a conf and classes directory, add to BBPATH
BBPATH .= ":${LAYERDIR}"

# We have recipes-* directories, add to BBFILES
BBFILES += "${LAYERDIR}/recipes-*/*/*.bb \
            ${LAYERDIR}/recipes-*/*/*.bbappend"

BBFILE_COLLECTIONS += "meta-gabriel"
BBFILE_PATTERN_meta-gabriel = "^${LAYERDIR}/"
BBFILE_PRIORITY_meta-gabriel = "6"

LAYERDEPENDS_meta-gabriel = "core"
LAYERSERIES_COMPAT_meta-gabriel = "kirkstone"
```
